## firmware/app/boards/kampi/zigbee_thermocouple/Kconfig.zigbee_thermocouple
```kconfig
config BOARD_ZIGBEE_THERMOCOUPLE
    select SOC_NRF54L15_CPUAPP if BOARD_ZIGBEE_THERMOCOUPLE_NRF54L15_CPUAPP
```

## firmware/app/boards/kampi/zigbee_thermocouple/board.yml
```yaml
board:
    name: zigbee_thermocouple
    full_name: Zigbee-Thermocouple
    vendor: kampi
    revision:
        format: number
        default: "1"
        revisions:
            - name: "1"
    socs:
        - name: nrf54l15
runners:
    run_once:
        '--recover':
            - runners:
                  - nrfjprog
                  - nrfutil
              run: first
              groups:
                  - boards:
                        - zigbee_thermocouple/nrf54l15/cpuapp
        '--erase':
            - runners:
                  - nrfjprog
                  - jlink
                  - nrfutil
              run: first
              groups:
                  - boards:
                        - zigbee_thermocouple/nrf54l15/cpuapp
        '--reset':
            - runners:
                  - nrfjprog
                  - jlink
                  - nrfutil
              run: last
              groups:
                  - boards:
                        - zigbee_thermocouple/nrf54l15/cpuapp
```

## firmware/app/src/events/Kconfig
```kconfig
module = ZIGBEE_THERMOCOUPLE_EVENTS
module-str = ZIGBEE_THERMOCOUPLE_EVENTS
source "subsys/logging/Kconfig.template.log_config"
```

## firmware/app/src/sensors/Kconfig
```kconfig
module = ZIGBEE_THERMOCOUPLE_SENSORS
module-str = ZIGBEE_THERMOCOUPLE_SENSORS
source "subsys/logging/Kconfig.template.log_config"
```
